#include "hal_data.h"

FSP_CPP_HEADER
void R_BSP_WarmStart(bsp_warm_start_event_t event);
FSP_CPP_FOOTER

#include "led/bsp_led.h"
#include "debug_uart/bsp_debug_uart.h"
#include "motor_gpt/bsp_motor_gpt.h"
#include "motor_icu/bsp_motor_icu.h"
#include "motor_control/bsp_motor_control.h"


extern volatile bool uart_recv_flag;

/*******************************************************************************************************************//**
 * main() is generated by the RA Configuration editor and is used to generate threads if an RTOS is used.  This function
 * is called by main() when no RTOS is used.
 **********************************************************************************************************************/
void hal_entry(void)
{
    /* TODO: add your own code here */
    /* LED初始化 */
	LED_Init();

	/* 串口初始化 */
	Debug_UART9_Init();
	
    /* 电机初始化 */
    bldcm_init();

    /* 电机使能 */
    bldcm_enable();

    printf("——————————————野火直流减速电机驱动演示程序——————————————\n\r");
    printf("输入命令(以回车结束)：\n\r");
    printf("< ? >       -帮助菜单\n\r");
    printf("v1[data]     -设置电机的速度（范围：0—100）\n\r");
    printf("d1[data]     -设置电机的方向，0:正向转，1:反向转\n\r");
    printf("v2[data]     -设置电机的速度（范围：0—100）\n\r");
    printf("d2[data]     -设置电机的方向，0:正向转，1:反向转\n\r");

	
	while(1)
	{
	    if(uart_recv_flag == true)
	    {
	        uart_recv_flag = false;
	        deal_uart_data();
	    }
	}
	
	
#if BSP_TZ_SECURE_BUILD
    /* Enter non-secure code */
    R_BSP_NonSecureEnter();
#endif
}





/*******************************************************************************************************************//**
 * This function is called at various points during the startup process.  This implementation uses the event that is
 * called right before main() to set up the pins.
 *
 * @param[in]  event    Where at in the start up process the code is currently at
 **********************************************************************************************************************/
void R_BSP_WarmStart (bsp_warm_start_event_t event)
{
    if(BSP_WARM_START_RESET == event)
    {
#if BSP_FEATURE_FLASH_LP_VERSION != 0

        /* Enable reading from data flash. */
        R_FACI_LP->DFLCTL = 1U;

        /* Would normally have to wait tDSTOP(6us) for data flash recovery. Placing the enable here, before clock and
         * C runtime initialization, should negate the need for a delay since the initialization will typically take more than 6us. */
#endif
    }

    if (BSP_WARM_START_POST_C == event)
    {
        /* C runtime environment and system clocks are setup. */

        /* Configure pins. */
        R_IOPORT_Open(&g_ioport_ctrl, g_ioport.p_cfg);
    }
}

#if BSP_TZ_SECURE_BUILD

BSP_CMSE_NONSECURE_ENTRY void template_nonsecure_callable ();

/* Trustzone Secure Projects require at least one nonsecure callable function in order to build (Remove this if it is not required to build). */
BSP_CMSE_NONSECURE_ENTRY void template_nonsecure_callable ()
{

}
#endif
