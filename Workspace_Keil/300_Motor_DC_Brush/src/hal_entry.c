#include "hal_data.h"

FSP_CPP_HEADER
void R_BSP_WarmStart(bsp_warm_start_event_t event);
FSP_CPP_FOOTER

#include "led/bsp_led.h"
#include "debug_uart/bsp_debug_uart.h"
#include "key/key.h"
#include "motor_dc_brush/motor_dc_brush.h"

extern char Order_Buff[1];
uint8_t Speed = 30;

/*******************************************************************************************************************//**
 * main() is generated by the RA Configuration editor and is used to generate threads if an RTOS is used.  This function
 * is called by main() when no RTOS is used.
 **********************************************************************************************************************/
void hal_entry(void)
{
    /* TODO: add your own code here */

	IRQ_Init();//按键中断初始化
	LED_Init(); // LED 初始化
	Debug_UART9_Init();//调试串口初始化

	initMotor();	   //初始化定时器
	
	MOTOR_PRINT("欢迎使用启明6T2开发板\r\n");
	MOTOR_PRINT("这是一个野火直流有刷电机控制实验\r\n");
	MOTOR_PRINT("按下按键1，有刷电机将启动\r\n");
	MOTOR_PRINT("按下按键2，有刷电机将停止\r\n");
	MOTOR_PRINT("\r\n************************************\r\n");
	MOTOR_PRINT("\r\n请根据以下详细命令控制有刷电机\r\n");
	MOTOR_PRINT("T -------------- 启动有刷电机\r\n");
	MOTOR_PRINT("P -------------- 停止有刷电机\r\n");
	MOTOR_PRINT("C -------------- 有刷电机顺时针旋转\r\n");
	MOTOR_PRINT("A -------------- 有刷电机逆时针旋转\r\n");
	MOTOR_PRINT("F -------------- 有刷电机加速旋转\r\n");
	MOTOR_PRINT("S -------------- 有刷电机减速旋转\r\n");
	
	while(1)
	{
		switch(Order_Buff[0]){
			case 'T':
				BRUSH_ENBLED;
				Clear_Buff();
				MOTOR_PRINT("\r\n有刷电机已启动\r\n");
				break;
			case 'P':
				BRUSH_DISENBLED;
				Clear_Buff();
				MOTOR_PRINT("\r\n有刷电机已停止\r\n");
				break;
			case 'C':
				BRUSH_CW;
				Clear_Buff();
				MOTOR_PRINT("\r\n有刷电机改为顺时针旋转\r\n");
				break;
			case 'A':
				BRUSH_CCW;
				Clear_Buff();
				MOTOR_PRINT("\r\n有刷电机改为逆时针旋转\r\n");
				break;
			case 'F':
				Speed += 10;
				setBrushSpeed(Speed);
				Clear_Buff();
				//MOTOR_PRINT("\r\n有刷电机旋转加速\r\n");
				break;
			case 'S':
				Speed -= 10;
				setBrushSpeed(Speed);
				Clear_Buff();
				//MOTOR_PRINT("\r\n有刷电机旋转减速\r\n");
				break;	
		}
	
	}
	
#if BSP_TZ_SECURE_BUILD
    /* Enter non-secure code */
    R_BSP_NonSecureEnter();
#endif
}

/*******************************************************************************************************************//**
 * This function is called at various points during the startup process.  This implementation uses the event that is
 * called right before main() to set up the pins.
 *
 * @param[in]  event    Where at in the start up process the code is currently at
 **********************************************************************************************************************/
void R_BSP_WarmStart (bsp_warm_start_event_t event)
{
    if (BSP_WARM_START_RESET == event)
    {
#if BSP_FEATURE_FLASH_LP_VERSION != 0

        /* Enable reading from data flash. */
        R_FACI_LP->DFLCTL = 1U;

        /* Would normally have to wait tDSTOP(6us) for data flash recovery. Placing the enable here, before clock and
         * C runtime initialization, should negate the need for a delay since the initialization will typically take more than 6us. */
#endif
    }

    if (BSP_WARM_START_POST_C == event)
    {
        /* C runtime environment and system clocks are setup. */

        /* Configure pins. */
        R_IOPORT_Open(&g_ioport_ctrl, g_ioport.p_cfg);
    }
}

#if BSP_TZ_SECURE_BUILD

BSP_CMSE_NONSECURE_ENTRY void template_nonsecure_callable ();

/* Trustzone Secure Projects require at least one nonsecure callable function in order to build (Remove this if it is not required to build). */
BSP_CMSE_NONSECURE_ENTRY void template_nonsecure_callable ()
{

}
#endif
